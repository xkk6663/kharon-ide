## CMakeLists.txt
```
# 镜像头版本（重要，别又踩回来）
#
# imgtool 不给 --version 时，镜像头里的版本恒为 0.0.0，于是「slot0 是哪一版、
# slot1 是哪一版」从镜像头根本读不出来，任何 bootloader 级版本判断
# （NO_DOWNGRADE、DIRECT_XIP 挑高版本、回滚前比新旧）全部失效。
#
# Zephyr 的干净入口是 CONFIG_MCUBOOT_EXTRA_IMGTOOL_ARGS（modules/Kconfig.mcuboot:160）。
# 坑在 sysbuild：cmake/modules/kconfig.cmake:303-317 在 SYSBUILD 模式下**只读
# sysbuild_cache 里名字形如 <镜像名>_CONFIG_xxx 的变量**，app 自己 CMakeLists 里的
# set(CONFIG_xxx CACHE ...) 会被直接忽略（我试过，.config 里仍是 ""）。
# 所以必须在构建命令行注入，镜像名就是工程名 s3_wifi_portal：
#
#   west build --sysbuild ... -- `
#     -Ds3_wifi_portal_CONFIG_MCUBOOT_EXTRA_IMGTOOL_ARGS="--version 1.<OTA_LOCAL_VERSION>.0"
#
# 单一事实来源仍是 src/ota.h 的 OTA_LOCAL_VERSION；构建后用
# tools\img_hdr.py 校验镜像头版本，对不上就别推板子。

cmake_minimum_required(VERSION 3.20.0)
find_package(Zephyr REQUIRED HINTS $ENV{ZEPHYR_BASE})
project(s3_wifi_portal)

# 芯片无关的公共模块由 Zephyr module `elab-app-common` 提供（breath_sync / ota_engine）。
# 本工程只负责时间、刷灯与 flash 后端；抽象接口见 elab-app-common/include/ota_engine.h。
set(APP_SRC ${CMAKE_CURRENT_SOURCE_DIR}/src)

# ======================================================== 四层 = 四个 OBJECT 库
#
#   目录                      target           允许的 -I（只列自己 + 下层）
#   src/l0/  ota ops          portal_eng       l0, src, common
#   src/l2/  服务             portal_svc       l2, l0, src, common
#   src/l1/  接口             portal_api       l1, l2, l0, src
#   src/main.c                app              l1, l2, l0, src
#
# "-I 只给到下层"就是物理防火墙：L2 想 include "http_core.h" 时编译器找不到该头
# （src/l1 不在它的 -I 里），于是"反向依赖"从纪律问题变成构建失败。
# 而它下面各层的头仍然可见 —— L2 调 ops_* / ota_* 这类方向是对的，不拦。
#
# 为什么是 OBJECT 而不是 STATIC（这一条很容易看起来无关紧要，实际会吃掉功能）：
#
#   HTTP_RESOURCE_DEFINE / SHELL_CMD_REGISTER / K_THREAD_DEFINE / SYS_INIT 都只
#   "往 linker section 里丢一条记录"，没有任何 C 代码按名字引用它们。
#   静态库的函数/数据按"有没有被引用"挑选 obj，这些只有注册表、没人引用的 obj
#   会被安静丢掉：链接不报错、镜像照出，跑起来就是 404 / 没有 shell 命令。
#
#   实测（2026-11-16，STATIC 版本）：elf 里 http_resource_desc 一个都不剩，
#   段 ._http_resource_desc_portal_service.static.* 为空；
#   build.ninja 的链接行里 libportal_*.a 落在 -Wl,--no-whole-archive 之后
#   （zephyr_library_named 在"application mode"下不会进 ZEPHYR_LIBS，见
#   extensions.cmake:878 zephyr_append_cmake_library 的那条 warning）。
#
#   用 OBJECT 库就回到改造前的语义：所有对象直接进 app，一个都不少，
#   同时每个 target 仍然有自己的 -I，防火墙照样成立。
#
# 编译成本：改一个 .c 只重编那一个文件再重链（实测 9–10 s / no-op 0.6 s），
# 分层的代价可以忽略 —— 真正的全量触发器是 prj.conf 和 *.overlay。

# ---------------------------------------------------------------- L0 引擎层
# ota(平台后端) / ops(重启记账) / breath_sync(灯规范) / ota_engine(OTA 协议层)
add_library(portal_eng OBJECT "")
target_link_libraries(portal_eng PUBLIC zephyr_interface)
target_sources(portal_eng PRIVATE
	src/l0/ota.c
	src/l0/ota_cloud.c
	src/l0/cloud_ops.c
	src/l0/ops.c
)
target_include_directories(portal_eng PRIVATE
	${APP_SRC}/l0
	${APP_SRC}
)

# ---------------------------------------------------------------- L2 服务层
# 凭据 / 扫描缓存 / 链路状态机 / SoftAP / 对时 / 出网自检 / 呼吸灯 / DNS 劫持。
# 这一层不认识 http.h，也不吐 JSON —— 它只提供"读快照 + 发动作"。
add_library(portal_svc OBJECT "")
target_link_libraries(portal_svc PUBLIC zephyr_interface)
target_sources(portal_svc PRIVATE
	src/l2/cred.c
	src/l2/wifi_scan.c
	src/l2/portal_ap.c
	src/l2/wifi_link.c
	src/l2/time_sync.c
	src/l2/netcheck.c
	src/l2/led_status.c
	src/l2/led_ctrl.c
	src/l2/dns_hijack.c
)
target_include_directories(portal_svc PRIVATE
	${APP_SRC}/l2
	${APP_SRC}/l0
	${APP_SRC}
)
# 服务层要记账（ops）、判"OTA 是否在写"（ota）、喂呼吸灯（breath_sync）
target_link_libraries(portal_svc PUBLIC portal_eng)

# ---------------------------------------------------------------- L1 接口层
# HTTP 资源 + 串口命令 + 上电自检：只做"协议 ↔ 快照"的翻译，不持有状态。
add_library(portal_api OBJECT "")
target_link_libraries(portal_api PUBLIC zephyr_interface)
target_sources(portal_api PRIVATE
	src/l1/http_core.c
	src/l1/api_wifi.c
	src/l1/api_dev.c
	src/l1/page.c
	src/l1/shell_cmds.c
	src/l1/selftest.c
)
target_include_directories(portal_api PRIVATE
	${APP_SRC}/l1
	${APP_SRC}/l2
	${APP_SRC}/l0
	${APP_SRC}
)
target_link_libraries(portal_api PUBLIC portal_svc)

# ---------------------------------------------------------------- L3 编排层
# app 只剩 main.c：注册事件回调、按顺序上电。顺序是产品行为，只属于这一层。
target_sources(app PRIVATE src/main.c)
target_include_directories(app PRIVATE
	${APP_SRC}/l1
	${APP_SRC}/l2
	${APP_SRC}/l0
	${APP_SRC}
)
# 三个 OBJECT 库的对象在这里一次性进 app。
# 注意不能写成 target_link_libraries(app PRIVATE portal_api)：OBJECT 库不会
# 自动把自己的对象交给下游（只有 STATIC/INTERFACE 会），必须显式取 TARGET_OBJECTS。
target_sources(app PRIVATE
	$<TARGET_OBJECTS:portal_eng>
	$<TARGET_OBJECTS:portal_svc>
	$<TARGET_OBJECTS:portal_api>
)

# HTTP server 的资源是"按服务名分组"的 iterable section：
#   HTTP_RESOURCE_DEFINE(name, portal_service, ...) 把资源放进
#   http_resource_desc_portal_service 段，服务用其 _start/_end 遍历。
# 段名是动态拼出来的，工具链不会预先生成，必须在应用里显式声明，
# 否则链接期报 undefined reference to `_http_resource_desc_portal_service_list_start'。
zephyr_linker_sources(SECTIONS ${CMAKE_CURRENT_SOURCE_DIR}/sections-rom.ld)
```

## sysbuild.conf
```
# sysbuild 侧配置（只影响"多镜像"这一层，不影响 app 自己的 prj.conf）
#
# 这块板（esp32s3_devkitc，4 MB flash）的分区表 partitions_0x0_amp_4M.dtsi
# 本来就带双槽：
#   mcuboot  @0x000000  64 KB
#   sys      @0x010000  64 KB
#   image-0  @0x020000  1344 KB   <- 当前运行槽
#   image-1  @0x170000  1344 KB   <- OTA 落盘槽
#   ...
#   storage  @0x3b0000  192 KB    <- NVS（凭据在这里，升级不动它）
# 所以 OTA 只需要"把 mcuboot 构建出来" + "app 挪到 0x20000"，不用自己画分区。
#
# 注意：这份分区表里**没有 scratch 分区**，所以 swap 方式只能是
# move / offset 这类二等分方案，不能用 swap-using-scratch。
SB_CONFIG_BOOTLOADER_MCUBOOT=y

# swap 模式**在这一层决定**，不是 app 目录下的 mcuboot.conf。
# 实测证据（build/esp32s3/s3ota/mcuboot/zephyr/.config.sysbuild 由 sysbuild 强制写入）：
#   CONFIG_BOOT_SWAP_USING_OFFSET=y
#   CONFIG_BOOT_SWAP_USING_MOVE=n
#   CONFIG_BOOT_SWAP_USING_SCRATCH=n
# 原因是 sysbuild 自己的 choice MCUBOOT_MODE 默认就是 SWAP_USING_OFFSET
# （zephyr/share/sysbuild/images/bootloader/Kconfig:35），而 app 目录下的
# mcuboot.conf 根本没被加进 mcuboot 的 CONF_FILE 列表 —— 写在那里等于没写。
# 这里显式写一遍：值虽然和默认相同（行为不变），但以后换 Zephyr 树默认变了，
# 这里会把它钉住，不会悄悄变成别的模式。
#
# ---------- 2026-11-15 起改用 MOVE 模式（回滚实验的结论驱动） ----------
# 原来用 OFFSET 模式的代价实测出来了：
#   OFFSET 要求"升级槽里的镜像从槽首 +0x1000 开始"（第一个扇区留给 swap 记状态），
#   而 swap 完成后 mcuboot 把旧镜像放回 slot1 的 **+0**（实测 p0 有 magic、+4096 没有）。
#   于是这一份旧镜像**不是合法的升级镜像布局**：一旦对它 boot_request_upgrade() 打 pending，
#   bootloader 在 boot_validate_slot() 里判 secondary 无效，走 loader.c:655-660 的
#   boot_scramble_slot() 把整槽擦掉（实测 slot1 变成全 0xFFFFFFFF），然后 swap type 回 NONE。
#   结论：OFFSET 模式下"把旧槽标 pending 让它搬回来"这条回滚路是**不通**的。
# MOVE 模式没有那 4 KB 偏移，镜像在槽首，swap 来回都是同一种布局，pending 才有意义。
# 代价：MOVE 在槽内做数据搬移，比 OFFSET 慢一些，且要求两槽等大（本板就是等大的 1344 KB）。
SB_CONFIG_MCUBOOT_MODE_SWAP_USING_OFFSET=n
SB_CONFIG_MCUBOOT_MODE_SWAP_USING_MOVE=y
```

## prj.conf
```kconfig
# s3_wifi_portal —— Wi-Fi APSTA 配网门户
#
# 三层能力：APSTA（SoftAP + STA 共存）、HTTP server（配网页）、mDNS（s3portal.local）
# 加上 WS2812 呼吸灯做状态指示（红=未连接 / 蓝=连接中 / 绿=已连接）

# ---------- 基础 ----------
CONFIG_CONSOLE=y
CONFIG_SERIAL=y
CONFIG_UART_CONSOLE=y
CONFIG_LOG=y

# ---------- 镜像头版本：已移出 Kconfig，改由 tools\build_ota.ps1 构建后重签 ----------
# 历史做法是在这里写 CONFIG_MCUBOOT_EXTRA_IMGTOOL_ARGS="--version=1.N.0"，
# 但 prj.conf 是 Kconfig 输入：每改一次版本就触发 reconfigure → 重新生成
# autoconf.h → 全树 .o 过期 → 整包全量重编（819 个文件，纯等待）。
# 现在版本唯一来源是 src/ota.h 的 OTA_LOCAL_VERSION，构建脚本用 imgtool
# 以真实版本重签 zephyr.bin（参数照抄 Zephyr 自己那条 sign 命令），
# 改版本只重编 ota.c/main.c 几个文件 + 一次 RSA 签名。
# 校验仍在：构建后 img_hdr.py 复查镜像头，不是 1.<OTA_LOCAL_VERSION>.0 就 exit 2。
CONFIG_LOG_DEFAULT_LEVEL=3
CONFIG_LOG_MODE_IMMEDIATE=y

CONFIG_SHELL=y
CONFIG_SHELL_BACKEND_SERIAL=y
CONFIG_SHELL_STACK_SIZE=4096

# ---------- 网络基础 ----------
CONFIG_NETWORKING=y
CONFIG_NET_IPV4=y
CONFIG_NET_IPV6=n
CONFIG_NET_TCP=y
CONFIG_NET_UDP=y
CONFIG_NET_SOCKETS=y
CONFIG_NET_DHCPV4=y
CONFIG_NET_DHCPV4_SERVER=y
# Captive Portal 三件套（缺一个手机就不会弹登录页）：
# 1) 把 AP 自己当成 DNS 发给手机，客户端 DNS 查询才会打到我们身上
CONFIG_NET_DHCPV4_SERVER_OPTION_DNS_ADDRESS="192.168.4.1"
# 2) DHCP option 114（RFC 8910）：直接告诉客户端门户地址（Android/Windows 认这个）
CONFIG_NET_DHCPV4_SERVER_OPTION_CAPTIVE_PORTAL=y
# 3) UDP:53 上的最小 DNS 劫持 + HTTP "/*" 302 由 main.c 实现
# AP 和 STA 各要一个 IPv4 地址，默认 1 个不够
CONFIG_NET_IF_MAX_IPV4_COUNT=2

# ---------- DHCP 地址池（这里踩过一次"手机一直转圈"） ----------
# 默认地址池只有 4 个（CONFIG_NET_DHCPV4_SERVER_ADDR_COUNT=4），
# 而 iOS/Android 每次"忘记网络再连"都会换一个随机 MAC（私有 Wi-Fi 地址），
# 每换一次 MAC 就占掉一个槽；再加上默认租约 86400 s（24 小时），
# 连几次之后池就满了 → 后续设备拿不到 IP → 手机卡在"正在获取 IP 地址"转圈。
# 所以：池扩到 16（192.168.4.10 ~ 192.168.4.25），租约缩到 900 s。
CONFIG_NET_DHCPV4_SERVER_ADDR_COUNT=16
CONFIG_NET_DHCPV4_SERVER_ADDR_LEASE_TIME=900
# 地址冲突后默认封锁 24 小时，缩短到 120 s，避免一个坏地址长期占坑
CONFIG_NET_DHCPV4_SERVER_ADDR_DECLINE_TIME=120
# 分配前会先 ICMP probe 该地址，默认等 1000 ms；缩到 200 ms 让手机更快拿到 IP
CONFIG_NET_DHCPV4_SERVER_ICMP_PROBE_TIMEOUT=200

CONFIG_NET_MGMT=y
CONFIG_NET_MGMT_EVENT=y
CONFIG_NET_MGMT_EVENT_INFO=y
CONFIG_NET_MGMT_EVENT_QUEUE_SIZE=16
CONFIG_NET_MGMT_EVENT_STACK_SIZE=4096

CONFIG_NET_PKT_RX_COUNT=16
CONFIG_NET_PKT_TX_COUNT=16
CONFIG_NET_BUF_RX_COUNT=32
CONFIG_NET_BUF_TX_COUNT=32

# ---------- 网络自检/调试 ----------
# 没有 NET_LOG 时 subsys/net 里的 LOG_ERR 会被整体编译掉，排错时看不到原因
CONFIG_NET_LOG=y
# net shell：串口里能跑 `net iface` / `net dns resolve s3portal.local` 自己验
CONFIG_NET_SHELL=y

# ---------- socket / 连接资源 ----------
# DHCPv4 server 依赖 socket service 线程，它把所有服务的 fd 汇总进一个 poll 数组，
# 数组大小就是 ZVFS_POLL_MAX（默认 3，本项目服务数 4 → 启动就报
# "You have 4 services to monitor but 3 poll entries configured" 并让线程失败）
CONFIG_ZVFS_POLL_MAX=16
# 连接上下文（net_context 池）：HTTP 监听+4 客户端 + DHCP(2) + mDNS + DNS 劫持 + 自检
# 默认 6 会被正好占满，第 7 个直接 net_context_get(): -2
CONFIG_NET_MAX_CONTEXTS=32
# TCP 连接表
# HTTP server（最多 4 个客户端）+ DHCP(2) + mDNS + 自检，默认 8 个连接上下文不够。
# 手机连上 AP 时 iOS/Android 会并发发多条 captive 探测，16 个会被瞬间占满
# （实测日志：net_conn: Not enough connection contexts -> net_tcp: Cannot allocate）
CONFIG_NET_MAX_CONN=32
# Wi-Fi 连接是在系统工作队列里跑的（net_mgmt → 驱动 → wpa_supplicant，调用很深），
# 默认 1024 会栈溢出，表现为切换线程时上下文损坏 / load prohibited 崩溃
CONFIG_SYSTEM_WORKQUEUE_STACK_SIZE=6144
# 栈保护哨兵：真溢出了会明确报 "stack overflow"，而不是随机崩溃
CONFIG_STACK_SENTINEL=y
# socket service 线程：DHCP server + DNS 劫持 + HTTP server + mDNS 的回调
# 全在这一个线程上跑。Kconfig 只有在启用 DHCP server 时才给 2400，
# 而我们把地址池从 4 扩到 16、又叠了通配 302 和 mDNS，
# 手机一连上 AP（DHCP + captive 探测并发）就栈溢出：
#   ** FATAL EXCEPTION / CPU 0 Invalid BSA / Current thread: net_socket_service
# 2400 → 8192，之后又叠了 SNTP / HTTP client 自检，仍偏紧 → 10240
# （Telnet 后端已于 2026-11 关闭，这项暂时不打算降回来：栈是按峰值配的，不是按平均值）
CONFIG_NET_SOCKETS_SERVICE_STACK_SIZE=10240

# ---------- Wi-Fi ----------
CONFIG_WIFI=y
# AP+STA 共存要求 WIFI_NM（新版 Wi-Fi 管理层）与 usage mode
CONFIG_WIFI_NM=y
CONFIG_WIFI_USAGE_MODE_STA_AP=y
# 注意：ESP32_WIFI_SOFTAP_SUPPORT 没有提示符（由 AP 相关符号间接推导），
# 在 prj.conf 里硬写会直接报 "not directly user-configurable"。
CONFIG_WIFI_MGMT_AP_MAX_NUM_STA=8

# ---------- HTTP server ----------
CONFIG_HTTP_SERVER=y
CONFIG_HTTP_SERVER_VERSION_1=y
# 只做 HTTP/1.1：关掉 HTTP/2、HTTP/3，省 flash 和 RAM
# CONFIG_HTTP_SERVER_VERSION_2 is not set
# CONFIG_HTTP_SERVER_VERSION_3 is not set
CONFIG_HTTP_SERVER_MAX_CLIENTS=4
# 4096 → 6144：handler 里要拼 status JSON（含 ota 段和 boot 子对象），
# 还要做 Basic Auth 的 base64 解码，余量不够了
CONFIG_HTTP_SERVER_STACK_SIZE=6144
# 通配资源（"/*"）：所有非精确路径 302 回配网页，用来触发 Captive Portal 弹窗
CONFIG_HTTP_SERVER_RESOURCE_WILDCARD=y

# ---------- mDNS ----------
CONFIG_MDNS_RESPONDER=y
# 打开解析器：板子自己也能反向查询（shell 里 `net dns resolve s3portal.local`
# 就能验证 responder 是否真的应答，不必等手机）
CONFIG_DNS_RESOLVER=y
CONFIG_MDNS_RESOLVER=y
CONFIG_NET_HOSTNAME_ENABLE=y
# 打开浏览器访问 http://s3portal.local 就靠这一行
CONFIG_NET_HOSTNAME="s3portal"

# ---------- RGB（WS2812 @ GPIO48，走 RMT） ----------
CONFIG_LED_STRIP=y

# ---------- 凭据持久化（NVS over settings） ----------
# 板级 dts 已自带 storage 分区（0x3b0000，192 KB），settings 会自动用它
CONFIG_FLASH=y
CONFIG_FLASH_MAP=y
CONFIG_FLASH_PAGE_LAYOUT=y
CONFIG_NVS=y
CONFIG_SETTINGS=y
CONFIG_SETTINGS_NVS=y

# Zephyr 官方凭据库：SSID/密码交给它落盘（后端走 settings over NVS），
# 应用层不用再自己拼一张定长表塞进 settings_save_one()。
CONFIG_WIFI_CREDENTIALS=y
CONFIG_WIFI_CREDENTIALS_MAX_ENTRIES=8
# 关掉库自带的"上电自动连接已存网络"：自动重连/退避/失败提示仍由本工程管理，
# 否则库里那套状态机会自己发起 CONNECT，和我们的 g_state 抢 STA。
CONFIG_WIFI_CREDENTIALS_CONNECT_STORED=n
CONFIG_WIFI_CREDENTIALS_SHELL=n

# ---------- 内存 ----------
# Wi-Fi 驱动自己要 51200 字节堆（HEAP_MEM_POOL_ADD_SIZE_ESP_WIFI 会自动加），
# 这里给应用层存量：HTTP server + JSON 缓冲 + 扫描结果。
# 公网 OTA（mbedTLS + X.509）进来后 DRAM 曾溢出 22 KB：TLS 上下文/PSA 密钥槽
# 都是静态 .bss，改从这两处腾地方 —— 64K → 48K（TLS 握手时 x509 解析走堆，
# 实测峰值 < 10 KB；Wi-Fi 的 51200 是另一个独立加量，不受这里影响）。
CONFIG_HEAP_MEM_POOL_SIZE=49152
CONFIG_MAIN_STACK_SIZE=4096

# ---------- OTA：mcuboot 双槽（sysbuild.conf 里开 SB_CONFIG_BOOTLOADER_MCUBOOT） ----------
# 这四个是 app 侧的最小组合：镜像管理器 + 往 slot1 流式写 + 增量擦除 + flash 回读校验
CONFIG_BOOTLOADER_MCUBOOT=y
CONFIG_IMG_MANAGER=y
CONFIG_MCUBOOT_IMG_MANAGER=y
CONFIG_IMG_ERASE_PROGRESSIVELY=y
CONFIG_IMG_ENABLE_IMAGE_CHECK=y
# 攒块大小 = flash 最小擦写粒度（4 KB 的 1/8），512 是 Zephyr 默认，实测吞吐够
CONFIG_IMG_BLOCK_BUF_SIZE=512

# IMG_MANAGER 的硬依赖：STREAM_FLASH 是 menuconfig，默认**不开**，
# 不显式打开的话上面那串 IMG_* 会被 Kconfig 静默丢弃（.config 里一个都不出现）。
CONFIG_STREAM_FLASH=y
# sys_reboot()，OTA 成功切槽后自己要重启
CONFIG_REBOOT=y

# ---------- 远程 shell：只在局域网侧，走 HTTP ----------
# 曾经开过 CONFIG_SHELL_BACKEND_TELNET(:23)，2026-11 关掉。原因是页面按受众分离后，
# Telnet 成了唯一的漏口：Zephyr 这版 telnet backend 绑 0.0.0.0、没有来源过滤、
# 也没有认证钩子，手机连上热点就能拿到一个无口令的交互式 shell——与"面向用户的
# 只做配网"直接冲突。远程执行改由 POST /api/shell 承担（应用层能按 getpeername
# 判来源、能要 k=），Telnet 的价值只剩交互手感，不值得为它把整条 shell 敞开。
# 注：改这里会触发一次全量重编（Kconfig 输入变了），属一次性代价。
# CONFIG_SHELL_BACKEND_TELNET is not set

# ---------- SNTP 对时 ----------
# 拿到 STA IP 之后问一次时间，给网页显示本地时钟，也给 OTA 的时间新鲜度留出可能。
CONFIG_SNTP=y

# ---------- HTTP 客户端：联网自检 ----------
# 连上 AP、拿到 IP 之后主动 GET 一个外部地址，确认真的能出网
# （captive portal 最典型的坑是"连上了但出不去"，只有主动发一次请求才知道）。
CONFIG_HTTP_CLIENT=y

# ---------- Wi-Fi 省电：关掉 modem sleep（"无缘无故断连"的头号嫌疑） ----------
# drivers/wifi/esp32/Kconfig.esp32:420 的 choice 默认就是 MIN_MODEM：STA 每个 DTIM
# 才醒一次收 beacon。而本板是 APSTA 共存、只有一颗射频 —— AP 在发包、STA 又要睡，
# 典型表现就是大师说的那种"信号很好（-49 dBm）却无故掉线"。
# NONE = modem 不睡，代价是常驻电流上去（开发期完全可接受）。
CONFIG_ESP32_WIFI_STA_POWER_SAVE_NONE=y
# BSS 空闲踢人阈值：默认 300 s。STA 睡着了路由器可能认为它不在线，
# 放宽到 600 s 给 modem sleep / 漫游留缓冲（即使以后又把省电开回来也不至于秒踢）。
CONFIG_WIFI_MGMT_BSS_MAX_IDLE_TIME=600

# ---------- 诊断能力（断连账本 / 栈水位 / 口令） ----------
# 注：CONFIG_HTTP_SERVER_CAPTURE_HEADERS 实测**不可用**——这版 Zephyr 的捕获状态
# 永远停在 NONE（全树只在 DROPPED 时改），populate_request_ctx() 于是恒把
# request_ctx->headers 置 NULL，任何基于请求头的鉴权都会恒放行。
# 所以鉴权改成应用层的 k= 查询参数（见 main.c auth_pass），这三行不再需要。
# CONFIG_HTTP_SERVER_CAPTURE_HEADERS is not set
# /api/boot 的线程栈水位：k_thread_foreach() 要 THREAD_MONITOR，
# k_thread_stack_space_get() 要 THREAD_STACK_INFO，缺一个就只剩空数组
CONFIG_THREAD_MONITOR=y
CONFIG_THREAD_STACK_INFO=y
# 实测 /api/boot 里最紧的一个就是 conn_mgr_monitor：512 B 的栈只剩 188 B。
# 它是处理网络事件回调的线程，真溢出会直接 FATAL 重启，给到 1024 留足余量。
CONFIG_NET_CONNECTION_MANAGER_MONITOR_STACK_SIZE=1024

# 断连账本 / 栈水位 / 口令 相关配置见下方"诊断能力"。
# ---------- 网页内远程命令（POST /api/shell） ----------
# shell_dummy 是"出不进串口、把输出收进内存缓冲"的测试后端：
# HTTP 线程把命令交给它执行，再用 shell_backend_dummy_get_output() 取回文本。
# 缓冲给 2 KB：`kernel thread` 这类命令的输出就接近 1.5 KB，400 B 的默认值会截断。
CONFIG_SHELL_BACKEND_DUMMY=y
CONFIG_SHELL_BACKEND_DUMMY_BUF_SIZE=2048
# ---------- OTA S3：PSK + HMAC-SHA256 ----------
# 这版树里默认只开了 SHA-256（S2 整包摘要用）。HMAC 是独立的能力位：
# 不开的话 psa_mac_compute() 直接返回 PSA_ERROR_NOT_SUPPORTED，
# 现象是每次上传都被判 badauth，而日志里看不出"算法没编进去"。
# 代价约 4~6 KB flash，槽上限 1280 KB，当前镜像 853 KB，余量足够。
CONFIG_PSA_WANT_ALG_HMAC=y
CONFIG_PSA_WANT_KEY_TYPE_HMAC=y

# ---------- 公网 OTA（TLS 客户端，ota_cloud） ----------
# TLS socket：mbedTLS 拉进 + 凭据库放内嵌 CA（hub_ca.inc，证书固定）
CONFIG_NET_SOCKETS_SOCKOPT_TLS=y
CONFIG_TLS_CREDENTIALS=y
CONFIG_MBEDTLS=y
# TLS1.2 协议栈本体：没它 MBEDTLS_SSL_CLI_C 不会进编译，sockets_tls 直接编译失败
CONFIG_MBEDTLS_SSL_PROTO_TLS1_2=y
# sockets_tls 的会话缓存依赖 session tickets（不打开编译不过）
CONFIG_MBEDTLS_SSL_SESSION_TICKETS=y
# 密钥交换：ECDHE-RSA（服务器证书 RSA-2048），带前向保密；ECDSA 用不上
CONFIG_MBEDTLS_KEY_EXCHANGE_ECDHE_RSA_ENABLED=y

# 具体 cipher suite —— 这一条才是"能用"的分界：
#   TLS_ECDHE_RSA_WITH_AES_128_GCM_SHA256 会 select 整条依赖链：
#     TLS1.2 PRF（密钥推导，缺了握手必挂）/ RSA-PKCS1v15-SIGN + RSA-PSS（证书验签）
#     / ECDH / AES / GCM / RSA+ECC 密钥对 IMPORT·EXPORT·GENERATE
# 注意：PSA 的 `*_KEY_PAIR_BASIC` 是**无 prompt 的派生符号**（Kconfig.psa.logic
# 由 IMPORT/EXPORT/GENERATE/DERIVE 推导），在 prj.conf 里硬写会直接报
# "not directly user-configurable"；写上游符号即可。
CONFIG_MBEDTLS_CIPHERSUITE_TLS_ECDHE_RSA_WITH_AES_128_GCM_SHA256=y

# PSA 密钥槽是**静态 .bss**：每槽 ~40 B + 最大非对称密钥长度（RSA-2048 私钥
# 约 600 B）。默认 16 槽纯属浪费，本工程同时最多用 3 把（TLS 客户端密钥、
# 服务器公钥、HMAC 的 PSK），给 4 槽：省下 ~10 KB DRAM。
CONFIG_MBEDTLS_PSA_KEY_SLOT_COUNT=4

# P-256 曲线必须显式开：MBEDTLS_ECP_LIGHT 一被打开（上面 ECC 密钥对生成就会开），
# ecp.h 要求至少有一条 ECP_DP_* 曲线，否则 #error "Missing definition of
# MBEDTLS_ECP_MAX_BITS"。ciphersuite 里只是 imply，不够硬。
CONFIG_PSA_WANT_ECC_SECP_R1_256=y
CONFIG_MBEDTLS_X509_CRT_PARSE_C=y
# 内嵌的 hub CA 是 PEM（src/l0/hub_ca.inc）：不开 PEM 解析，mbedtls 会报
# -0x2180 (X509_INVALID_FORMAT)，表现为 "Failed to parse certificate on tag 1"。
CONFIG_MBEDTLS_PEM_PARSE_C=y
# OFFER JSON 解析（zephyr/data/json，静态描述符，无动态分配）
CONFIG_JSON_LIBRARY=y
```

## mcuboot.conf
```kconfig
# ⚠️ 这个文件在当前这版 Zephyr 树里**不生效**，保留它只是为了不再有人被它误导。
#
# 为什么会以为它生效：sysbuild 有"读 app 目录下 mcuboot.conf"的约定。
# 实测这棵树没有把它接进去：
#   build/esp32s3/s3ota/mcuboot/CMakeCache.txt 里
#   CONF_FILE = bootloader/mcuboot/boot/zephyr/prj.conf ; .../socs/esp32s3_procpu.conf
#   —— 我们的 mcuboot.conf 不在这个列表里。
# 而且 sysbuild 会用 FORCED_CONF_FILE 强制写入
#   build/esp32s3/s3ota/mcuboot/zephyr/.config.sysbuild
#   （CONFIG_BOOT_SWAP_USING_OFFSET=y / MOVE=n / SCRATCH=n / UPGRADE_ONLY=n），
# 强制文件优先级高于一切普通 fragment，所以即使接进去了也会被它盖掉。
#
# 直接证据：这里曾写过 CONFIG_MCUBOOT_LOG_LEVEL_INF=y，
# 而实际编出来的 mcuboot .config 是 CONFIG_MCUBOOT_LOG_LEVEL_OFF=y（soc fragment 的值）。
#
# 真正要改的开关在哪：
#   ① swap 模式（offset / move / scratch / upgrade-only）
#        → applications/esp32s3/s3_wifi_portal/sysbuild.conf
#          SB_CONFIG_MCUBOOT_MODE_SWAP_USING_OFFSET=y
#   ② mcuboot 自己的日志（要看到 swap 决策就必须开，验收完可关以省 ~20 KB）
#        → 只能在 mcuboot 侧配，sysbuild 没有对应 SB_CONFIG；
#          需要时用 -Dmcuboot_CONFIG_... 或直接改
#          zephyr_k/bootloader/mcuboot/boot/zephyr/socs/esp32s3_procpu.conf
#          注意它现在把日志关得很彻底（LOG_DEFAULT_LEVEL=0 + MCUBOOT_LOG_LEVEL_OFF）。
#   ③ 签名算法 / 密钥
#        → 也由 .config.sysbuild 强制：现在 BOOT_SIGNATURE_TYPE_RSA=y，
#          key = bootloader/mcuboot/root-rsa-2048.pem
```

## src/main.c
```c
/*
 * main —— L3 编排层（本工程唯一"知道全局顺序"的地方）
 *
 * 改造前：这个文件 4399 行、83 个函数、104 个全局，任何两层之间都能互相摸。
 * 改造后：本文件只剩三件事
 *   1) 注册 net_mgmt 回调，把事件**翻译**成模块调用（不写业务逻辑）；
 *   2) 上电时序：等驱动 → 开 AP → DNS 劫持 → HTTP → 自检 → 读 NVS → 起 OTA → 自动连；
 *   3) 把"谁先谁后"这件事单独留在这里 —— 顺序是产品行为，不属于任何一层服务。
 *
 * 依赖方向：main → L1(selftest) / L2(全部服务) / L0(ops, ota)，不反向。
 */
#include <stdlib.h>
#include <string.h>
#include <stdio.h>
#include <errno.h>

#include <zephyr/kernel.h>
#include <zephyr/logging/log.h>
#include <zephyr/net/net_if.h>
#include <zephyr/net/net_ip.h>
#include <zephyr/net/net_mgmt.h>
#include <zephyr/net/wifi_mgmt.h>
#include <zephyr/net/http/server.h>
#include <zephyr/settings/settings.h>

#include "portal_cfg.h"
#include "cred.h"
#include "wifi_scan.h"
#include "wifi_link.h"
#include "portal_ap.h"
#include "time_sync.h"
#include "netcheck.h"
#include "led_status.h"
#include "dns_hijack.h"
#include "selftest.h"
#include "ota.h"
#include "ota_cloud.h"
#include "cloud_ops.h"
#include "ops.h"

LOG_MODULE_REGISTER(portal, LOG_LEVEL_INF);

/* ---------------------------------------------------------------- 事件分派
 * 这里只做"事件 → 谁负责"的映射。原来每个 case 里塞着十几行状态赋值，
 * 现在一行调用；想知道连上之后做了什么，去 wifi_link.c 看 link_ev_connect_result。
 */
static void wifi_event_handler(struct net_mgmt_event_callback *cb, uint64_t event,
			       struct net_if *iface)
{
	switch (event) {
	case NET_EVENT_WIFI_SCAN_RESULT:
		scan_cache_add((const struct wifi_scan_result *)cb->info);
		break;

	case NET_EVENT_WIFI_SCAN_DONE:
		/* 扫描结束必须复位"正在扫描"，否则之后的扫描请求会被一直吃掉。
		 * 这件事属于扫描缓存，不属于分派器。 */
		scan_event_done();
		break;

	case NET_EVENT_WIFI_CONNECT_RESULT: {
		const struct wifi_status *st = (const struct wifi_status *)cb->info;

		link_ev_connect_result(st ? st->status : 0);
		break;
	}

	case NET_EVENT_WIFI_DISCONNECT_RESULT:
		link_ev_disconnect_result((const struct wifi_status *)cb->info);
		break;

	case NET_EVENT_WIFI_AP_ENABLE_RESULT:
		LOG_INF("SoftAP \"%s\" is up, join it and open http://%s.local/", AP_SSID,
			CONFIG_NET_HOSTNAME);
		/* DHCP 服务必须在 AP 真正 up 之后才能起，提前调会返回失败 */
		ap_ev_enabled(iface);
		break;

	case NET_EVENT_WIFI_AP_STA_CONNECTED:
		ap_ev_client_add((const struct wifi_ap_sta_info *)cb->info);
		break;

	case NET_EVENT_WIFI_AP_STA_DISCONNECTED:
		ap_ev_client_remove((const struct wifi_ap_sta_info *)cb->info);
		break;

	default:
		break;
	}
}

/* 拿到 STA IP 之后的四步：记 IP → 身份自检 → 设默认出口 → 补默认路由 → 起对时/自检。
 * 每一步都落在一个模块里，顺序由这里决定（"先能出网，才值得对时"）。 */
static void ipv4_event_handler(struct net_mgmt_event_callback *cb, uint64_t event,
			       struct net_if *iface)
{
	if (event != NET_EVENT_IPV4_ADDR_ADD || iface != link_sta_iface()) {
		return;
	}

	const struct in_addr *addr = (const struct in_addr *)cb->info;

	if (addr == NULL) {
		return;
	}

	link_ev_got_ip(iface, addr);

	/* 局域网侧的身份自检：连自己的 STA 地址，期望响应头 X-Portal-Scope: dev */
	http_self_test_scope(link_ip(), "dev");

	/* 开发者接口的自检只能从这里做：DEV_GUARD 规定它们对 AP 侧一律回 404，
	 * 从 192.168.4.1 打过去只会得到三条假失败（改造前日志里那三条 404 就是
	 * 这么来的，看着像"接口没注册"，其实是权限分层的正常行为）。
	 * 口令取运行中的 ops_auth_pw()，别把默认口令抄第二份。 */
	{
		char path[96];

		snprintf(path, sizeof(path), "/api/ota/slots?k=%s", ops_auth_pw());
		http_self_test_host(link_ip(), path);
		snprintf(path, sizeof(path), "/api/drops?k=%s", ops_auth_pw());
		http_self_test_host(link_ip(), path);
	}

	/* AP 和 STA 同时在线，默认 net_if 不一定是 STA（实测是 AP）。
	 * 而 sntp_simple() / http_client_req() 这类没有 iface 参数的 API，
	 * 出网时按默认接口走 —— 走 AP 就永远出不去，表现为 SNTP -ETIMEDOUT、
	 * HTTP -EINVAL 且耗时接近 0。把 STA 显式设为默认接口即可。 */
	net_if_set_default(iface);

	char gw[NET_IPV4_ADDR_LEN] = "";

	ensure_default_route(iface, link_ip(), gw, sizeof(gw));
	link_set_gw(gw);

	/* 有 IP 才算真的能出网，这时才值得去对时、去发探测请求 */
	start_net_services();
}

/* ---------------------------------------------------------------- 启动时序 */
int main(void)
{
	static struct net_mgmt_event_callback wifi_cb;
	static struct net_mgmt_event_callback ipv4_cb;

	LOG_INF("s3_wifi_portal booting ...");

	/* 呼吸灯先自由运行：此时还没连上路由，等级 0（灯半亮）。
	 * SNTP 成功那一刻起 time_sync 会把真实 UTC 喂进去，灯并到全局时间并恢复满亮。 */
	led_clock_start();

	net_mgmt_init_event_callback(&wifi_cb, wifi_event_handler,
				     NET_EVENT_WIFI_SCAN_RESULT |
				     NET_EVENT_WIFI_SCAN_DONE |
				     NET_EVENT_WIFI_CONNECT_RESULT |
				     NET_EVENT_WIFI_DISCONNECT_RESULT |
				     NET_EVENT_WIFI_AP_ENABLE_RESULT |
				     NET_EVENT_WIFI_AP_STA_CONNECTED |
				     NET_EVENT_WIFI_AP_STA_DISCONNECTED);
	net_mgmt_add_event_callback(&wifi_cb);

	net_mgmt_init_event_callback(&ipv4_cb, ipv4_event_handler, NET_EVENT_IPV4_ADDR_ADD);
	net_mgmt_add_event_callback(&ipv4_cb);

	/* 接口对象归各自模块持有：AP 归 portal_ap，STA 归 wifi_link。
	 * 这里只是问它们"拿到没有"，不再自己存两个全局。 */
	if (ap_iface_get() == NULL || link_sta_iface() == NULL) {
		LOG_ERR("APSTA interfaces not available (ap=%p sta=%p)",
			ap_iface_get(), link_sta_iface());
		return 0;
	}

	/* Wi-Fi 驱动初始化要一点时间，等一下再开 AP */
	k_msleep(2000);

	enable_softap();

	/* AP 起来之后再开 DNS 劫持（线程里会 bind udp/53） */
	start_dns_hijack();

	int ret = http_server_start();

	if (ret) {
		LOG_ERR("HTTP server start failed (%d)", ret);
	}

	/* 把 NVS 里的凭据读回来；settings_load() 会回调 cred_settings_set() */
	ret = settings_subsys_init();
	if (ret) {
		LOG_ERR("settings init failed (%d)", ret);
	} else {
		ret = settings_load();
		if (ret) {
			LOG_ERR("settings load failed (%d)", ret);
		}
	}

	/* 启动/崩溃计数必须排在 settings_load() 之后：它靠 NVS 里上次留下的
	 * dirty 标志判断"上一次是不是异常退出"。 */
	ops_boot_init();

	/* 旧固件那张表已经（可能）在凭据表里了，搬到 wifi_credentials 存储去 */
	cred_migrate_legacy();

	/* OTA 接收端必须在 settings_load() 之后起：它要从 settings 里把上次用过的
	 * nonce 读回来，早于这里启动会退回 0，防重放就形同虚设。 */
	ota_srv_start();

	/* 公网 OTA 拉取端：settings_load() 之后起（token/nonce 都依赖 NVS）。
	 * 周期 check 由专属线程驱动，这里只做启动与 TLS 凭据注册。 */
	/* l0 的命令执行器不认识 l2 —— 把真实函数在这里挂进去（分层防火墙：
	 * l0 只看函数指针，不 include l2 的头）。 */
	{
		static const struct cloud_ops_hooks cloud_hooks = {
			.ip = link_ip,
			.ssid = link_target_ssid,
			.rssi = wifi_rssi,
			.net_http = net_http_status,
			.net_dns_rc = net_dns_rc,
			.led_test = led_status_test,
		};

		cloud_ops_bind(&cloud_hooks);
	}

	ota_cloud_start();

	/* 有已保存网络就自动连：逐条轮，每条试满 AUTO_RETRY_MAX 次再换下一条。
	 *
	 * ★ 这一步必须紧跟 settings_load()，不能排在那 5 个自检后面：
	 * 自检验的是"AP 网段的 HTTP 能不能通"，跟 STA 什么时候能出网无关，
	 * 把它们排在连接前面，等于让用户多等 4 s（实测 6.56 s 才开始连）。
	 * 连接本身跑在系统工作队列里，主线程后面做自检不会挡住它。 */
	link_boot_autoconnect();

	/* RSSI 采样：先排一次，之后就由 handler 自己 reschedule 下去 */
	link_rssi_sampling_start();

	LOG_INF("portal ready: AP=%s  url=http://%s.local/", AP_SSID, CONFIG_NET_HOSTNAME);

	/* 上电自检挪到连接发起之后（它只验 AP 侧）。
	 * 这里刻意不请求 /api/scan —— 那会真的发起一次全信道扫描（实测 ~10 s），
	 * 正好和紧接着的 STA 连接撞车，还白白清空扫描缓存。
	 * 开发者接口（/api/shell、/api/ota/slots、/api/drops）不在这里验：
	 * DEV_GUARD 规定它们对 AP 侧一律回 404，从 192.168.4.1 打过去只会得到
	 * 三条假失败；它们改在拿到 STA IP 之后从局域网侧验（见 ipv4_event_handler）。 */
	k_msleep(500);
	http_self_test("/api/wifi");
	http_self_test_scope(AP_IP, "user");
	k_msleep(1500);
	http_self_test("/api/saved");
	k_msleep(1500);
	http_self_test("/generate_204");
	dns_self_test();

	return 0;
}
```

## src/portal_cfg.h
```c
/*
 * portal_cfg.h —— 本工程共享的常量（只有宏，没有状态）
 *
 * 这些数原来是散在 main.c 顶部的 #define，被 4 个模块用到：改一次要翻三处。
 * 收在这里之后，"AP 密码 / 重连次数 / 退避上限"各有一处唯一定义。
 *
 * 注意：都是**编译期常量**，不引入 Kconfig —— 改 prj.conf 会触发全量重编，
 * 而改一个头文件只重编 include 它的 4~5 个文件。
 */
#ifndef PORTAL_CFG_H_
#define PORTAL_CFG_H_

/* ---- SoftAP 身份 ---- */
#define AP_SSID             "S3-Portal"
#define AP_PSK              "<REDACTED-PSK>"     /* WPA2 要求至少 8 位 */
#define AP_IP               "192.168.4.1"
#define AP_NETMASK          "255.255.255.0"
#define AP_POOL             "192.168.4.10"    /* DHCP 起始地址 */

/* ---- 一次连接尝试 ---- */
#define CONNECT_TIMEOUT_MS  20000

/* ---- 上电自动重连（逐条轮） ---- */
#define AUTO_RETRY_MAX      3
#define AUTO_RETRY_DELAY_MS 3000
/* 第一次失败后只等 0.5 s 就重试：实测在"AP 刚起、驱动还没扫过"的窗口里
 * 第一次 CONNECT 会在 0.6 s 内被拒（status 1），此时等满 3 s 纯属白等。
 * 后面几次仍用 3 s —— 那才是"真的连不上"该给的间隔。 */
#define AUTO_RETRY_FIRST_MS 500

/* ---- 信道对齐（单射频 APSTA 的核心约束） ---- */
/* 扫描缓存多久算"过期"：超过这个年龄就不拿它做信道判断，宁可先扫一次 */
#define CHANNEL_CACHE_TTL_MS 60000
/* 等了多久还拿不到 SCAN_DONE 就放弃等待（ESP32 全信道扫描实测 ~10 s） */
#define ALIGN_SCAN_WAIT_MS   15000
/* 对齐最多走几步：0 = 还没试过 → 1 = 已经做过一次 0.5 s 廉价重试 →
 * 2 = 已经搬过 AP 或扫过信道（到此封顶，之后回落到普通重试/退避）。
 * 封顶是为了防止"扫一次 → 连 → 失败 → 再扫"的无限循环。
 * 注意顺序：能靠缓存直接搬 AP 的第二档，比全信道扫描（~10 s）便宜得多，
 * 所以扫描只留给"缓存里压根没有这个网络"的情形。 */
#define ALIGN_STEP_MAX      2

/* ---- 运行期掉线重连（退避） ---- */
#define RT_RETRY_MAX        10
#define RT_RETRY_BASE_MS    3000
#define RT_RETRY_CAP_MS     24000
#define CONN_STABLE_MS      30000

#endif /* PORTAL_CFG_H_ */
```
