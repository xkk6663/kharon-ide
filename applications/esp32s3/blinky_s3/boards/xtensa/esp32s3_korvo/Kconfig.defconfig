## applications/esp32s3/blinky_s3/boards/xtensa/esp32s3_korvo/board.yml
```yaml
board:
  name: esp32s3_korvo
  full_name: ESP32-S3 Korvo Custom Board
  vendor: espressif
  socs:
  - name: esp32s3
```

## applications/esp32s3/blinky_s3/boards/xtensa/esp32s3_korvo/esp32s3_korvo_procpu_defconfig
```kconfig
# SPDX-License-Identifier: Apache-2.0

CONFIG_CONSOLE=y
CONFIG_SERIAL=y
CONFIG_UART_CONSOLE=y
CONFIG_GPIO=y
CONFIG_CLOCK_CONTROL=y

# ESP32 的中断分配器（intc_esp32.c）用 k_malloc，所以要给内核堆
CONFIG_HEAP_MEM_POOL_SIZE=4096
```

## applications/esp32s3/input_btn/boards/xtensa/esp32s3_korvo/Kconfig.esp32s3_korvo
```kconfig
# SPDX-License-Identifier: Apache-2.0

config BOARD_ESP32S3_KORVO
	select SOC_ESP32S3
	select SOC_ESP32S3_PROCPU if BOARD_ESP32S3_KORVO_ESP32S3_PROCPU
	help
	  Custom ESP32-S3 board (Korvo carrier + S3 module).
```
