/*
 * 最小开发板（只接原生 USB 口）的控制台切换 overlay
 *
 * 板级 dts 的 chosen 里 console/shell 都指向 uart0（走 CP2102 桥）。
 * 本板没有接 UART 口，只能走芯片内置 USB-Serial-JTAG -> usb_serial，
 * 否则串口一片空白（日志和 shell 都收不到）。
 *
 * 用法（构建官方 sample 时命令行传）：
 *   west build -b esp32s3_devkitc/esp32s3/procpu <sample> -d build\samples\esp32s3\shell\default `
 *     -DEXTRA_DTC_OVERLAY_FILE=<本文件绝对路径>
 */

&usb_serial {
	status = "okay";
};

/ {
	chosen {
		zephyr,console = &usb_serial;
		zephyr,shell-uart = &usb_serial;
	};
};
