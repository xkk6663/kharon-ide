/*
 * korvo_i2c.dtsi —— Korvo-1 的 I2C0 接线
 *
 * 上游 coreboard 的 i2c0 默认是 GPIO51/GPIO50；Korvo-1 是 GPIO0(SDA)/GPIO1(SCL)，
 * 且这两根线在板上已经各有上拉，这里再配一次内部上拉 + 开漏输出，
 * 是为了在"板上拉缺失/虚焊"时仍能扫到 ES8389（实测 0x10 / 0x14）。
 *
 * 只有 korvo_lab / korvo_shell 需要（korvo_apps / korvo_sys 不碰 I2C），
 * 所以单独一个文件，不进 korvo_board.dtsi。
 *
 * 用法： #include "../common/korvo_i2c.dtsi"
 */

&pinctrl {
	i2c0_korvo: i2c0_korvo {
		group1 {
			pinmux = <I2C0_SDA_GPIO0>, <I2C0_SCL_GPIO1>;
			bias-pull-up;
			drive-open-drain;
			output-high;
		};
	};
};

&i2c0 {
	pinctrl-0 = <&i2c0_korvo>;
	pinctrl-names = "default";
	clock-frequency = <I2C_BITRATE_FAST>;
	status = "okay";
};
