## CMakeLists.txt
```
cmake_minimum_required(VERSION 3.20.0)
find_package(Zephyr REQUIRED HINTS $ENV{ZEPHYR_BASE})
project(korvo_template)

# 新建工程时，把 project() 的名字改成你的工程名（只影响产物命名，不影响功能）
target_sources(app PRIVATE src/main.c)
```

## prj.conf
```kconfig
# 新建工程的最小 Kconfig（应用级）
# 只开"想跑起来看输出"必需的三项；其余按需往下加（每加一项都要能说清为什么）

CONFIG_CONSOLE=y
CONFIG_SERIAL=y
CONFIG_UART_CONSOLE=y

# 摸 GPIO 才需要；这个模板用 PA_CTRL 演示 gpio_dt_spec 的取法
CONFIG_GPIO=y

CONFIG_MAIN_STACK_SIZE=2048
```

## boards/esp32s31_function_coreboard_esp32s31_hpcore.overlay
```dts
/*
 * 新建工程的 Korvo-1（ESP32-S31）板级 overlay
 *
 * 文件名 = 板目标下划线化：esp32s31_function_coreboard/esp32s31/hpcore
 *          -> esp32s31_function_coreboard_esp32s31_hpcore.overlay
 *
 * 一行 #include 就把 Korvo-1 的公共差异（PA_CTRL / WS2812@GPIO37 / adc0）带进来。
 * 相对路径相对本文件（boards\），所以是 ../../common\。
 * 本工程独有的节点往下加；不需要就删掉这一行。
 */

#include "../../common/korvo_board.dtsi"

/* 示例：给本工程单独加一个"自己能找到"的别名
 * （别名是"代码里的名字"，别和硬件节点名混为一谈）
 */
/ {
	aliases {
		my-pa = &pa_ctrl;
	};
};
```

## src/main.c
```c
/*
 * _template — 新建工程的骨架（第四课"新建"那一节的实物）
 *
 * 这个 main.c 只做三件事：
 *   1. 从设备树别名拿一个 gpio_dt_spec（对应教程里"led"那一行）
 *   2. 用 device_is_ready / gpio_is_ready_dt 判"驱动有没有真的进镜像"
 *   3. 打印横幅 + 定频心跳，证明工程跑起来了
 *
 * 注意：这里用的是 PA_CTRL（功放使能脚）。只配置成"不激活"，**不要 toggle**，
 * 否则喇叭会有爆音。要练点灯请用 WS2812（led_strip API），见 lesson-04 第三节。
 */

#include <zephyr/kernel.h>
#include <zephyr/device.h>
#include <zephyr/drivers/gpio.h>
#include <zephyr/sys/printk.h>

/* 别名来自 app.overlay 里的 my-pa -> pa_ctrl（app.overlay 又 include 了公共片段） */
#define PA_NODE DT_ALIAS(my_pa)
static const struct gpio_dt_spec pa = GPIO_DT_SPEC_GET(PA_NODE, gpios);

int main(void)
{
	int ret;

	printk("\n=== korvo_template 启动 ===\n");
	printk("board: %s\n", CONFIG_BOARD_TARGET);

	if (!gpio_is_ready_dt(&pa)) {
		/* 走到这里 = adc/gpio 驱动没进镜像，先查 prj.conf，不是查 dts */
		printk("PA_CTRL 设备未就绪（检查 CONFIG_GPIO=y 与 overlay 是否生效）\n");
		return 0;
	}

	ret = gpio_pin_configure_dt(&pa, GPIO_OUTPUT_INACTIVE);
	printk("PA_CTRL: port=%s pin=%u configure=%d\n", pa.port->name, pa.pin, ret);

	while (1) {
		printk("[tick] uptime=%u ms\n", k_uptime_get_32());
		k_msleep(1000);
	}

	return 0;
}
```
